## fit-image/icm4.its
```
/*
 * icm4.its - Flattened Image Tree file for the ICM4
 *
 * Copyright (C) 2022 Loram Technologies, Inc.
 * Author: Leslie Davis <leslie.g.davis@loram.com>
 *
 * References:
 * https://github.com/u-boot/u-boot/blob/master/doc/uImage.FIT/source_file_format.txt
 * https://lists.denx.de/pipermail/u-boot/2018-January/318553.html
 * https://www.thegoodpenguin.co.uk/blog/u-boot-fit-image-overview/
 */
/dts-v1/;

/ {
	// use sed to update version before building image
	// sed "s/%%LTI_IMAGE_VERSION%%/${LTI_IMAGE_VERSION}/g" icm4.its.in > icm4.its
	description = "%%LTI_IMAGE_VERSION%%";
	#address-cells = <1>;

	images {
		kernel {
			description = "Linux kernel";
			data = /incbin/("./zImage");
			type = "kernel";
			arch = "arm";
			os = "linux";
			compression = "none";
			load = <0x22000000>;
			entry = <0x22000000>;
			hash-1 {
				algo = "md5";
			};
		};

		fdt {
			description = "Flattened Device Tree";
			//data = /incbin/("./icm4.dtb");
			data = /incbin/("./at91-sama5d2_xplained.dtb");
			type = "flat_dt";
			arch = "arm";
			compression = "none";
			load = <0x23000000>;
			hash-1 {
				algo = "md5";
			};
		};

		ramdisk {
			description = "Root Filesystem";
			//data = /incbin/("icm4_root.squashfs");
			//data = /incbin/("./core-image-minimal-sama5d2-xplained-sd.squashfs");
			data = /incbin/("./icm4-image-sama5d2-xplained-sd.squashfs");
			type = "ramdisk";
			arch = "arm";
			os = "linux";
			compression = "none";
			hash-1 {
				algo = "md5";
			};
		};
	};

	configurations {
		default = "base";

		base {
			description = "Base System";
			kernel = "kernel";
			fdt = "fdt";
			ramdisk = "ramdisk";
		};
	};
};
```
